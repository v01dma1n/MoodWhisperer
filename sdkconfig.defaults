## sdkconfig.defaults
```kconfig
# MoodWhisperer sdkconfig defaults.
# These are the minimum non-default settings the firmware expects.
# Apply with:  idf.py reconfigure  (first build picks them up automatically).

# --- Target ------------------------------------------------------------------
CONFIG_IDF_TARGET="esp32"

# --- Flash size --------------------------------------------------------------
# The WROOM module carries a 4 MB flash chip; setting this eliminates the
# "detected size larger than binary header" warning and lets the partition
# table use the full chip.
CONFIG_ESPTOOLPY_FLASHSIZE_4MB=y

# --- Main task stack ---------------------------------------------------------
# The app task runs app logic, WiFi, NTP, and the AP captive portal.
CONFIG_ESP_MAIN_TASK_STACK_SIZE=8192

# --- Partition table ---------------------------------------------------------
# Custom table gives NVS enough room for preferences plus room for OTA later.
CONFIG_PARTITION_TABLE_CUSTOM=y
CONFIG_PARTITION_TABLE_CUSTOM_FILENAME="partitions/partitions.csv"

# --- WiFi --------------------------------------------------------------------
CONFIG_ESP_WIFI_STATIC_RX_BUFFER_NUM=10
CONFIG_ESP_WIFI_DYNAMIC_RX_BUFFER_NUM=32

# --- HTTP server -------------------------------------------------------------
# Captive portal needs a generous URI length for the POST of all form fields.
CONFIG_HTTPD_MAX_URI_LEN=1024
CONFIG_HTTPD_MAX_REQ_HDR_LEN=1024

# --- SNTP --------------------------------------------------------------------
CONFIG_LWIP_SNTP_MAX_SERVERS=3

# --- FreeRTOS tick rate ------------------------------------------------------
# 1 kHz tick gives millisecond-granular timing for animations.
CONFIG_FREERTOS_HZ=1000

# --- FreeRTOS stack overflow detection ---------------------------------------
# Method 2 (canary pattern) — when a task overflows, the panic handler names
# the offending task instead of leaving us to guess from a corrupted IRET.
# Tiny runtime cost at task-switch only.
CONFIG_FREERTOS_CHECK_STACKOVERFLOW_CANARY=y
CONFIG_FREERTOS_WATCHPOINT_END_OF_STACK=y

# --- IPC task stack ----------------------------------------------------------
# Was 2048; bumped to 4096 as a precaution. The actual overflow is elsewhere
# (see ISR stack below) — ipc1 watermark shows 3580 bytes free in all captures.
CONFIG_ESP_IPC_TASK_STACK_SIZE=4096

# --- Per-core ISR stack ------------------------------------------------------
# Default 1536 bytes. `_frxt_int_enter` in the Xtensa FreeRTOS port switches
# from the interrupted task's stack to this static per-core stack before
# dispatching interrupt handlers. Core 1's ISR SP is fixed at ~0x3ffb27d0
# across every build — it's port_IntStack[1][configISR_STACK_SIZE-1], not a
# task stack. WiFi client activity (AP portal submit + STA connect) chains
# multiple interrupt handlers on Core 1, overflowing this 1536-byte stack
# downward into _xt_interrupt_table[], zeroing handler entries. The next
# interrupt fires, callx4 through a NULL handler → PC=0 → EXCM=1 already set
# → InstrFetchProhibited double-exception. A1=0x3ffb27d0 in every crash dump
# is the ISR stack SP, not any task's SP. 4096 gives ~2.5 KB of headroom.
CONFIG_FREERTOS_ISR_STACKSIZE=4096

# --- FreeRTOS task trace / watermark logging ---------------------------------
# Enables vTaskList() and uxTaskGetStackHighWaterMark(). Used by the periodic
# watermark dump in appTask to catch which task is close to overflow.
CONFIG_FREERTOS_USE_TRACE_FACILITY=y
CONFIG_FREERTOS_USE_STATS_FORMATTING_FUNCTIONS=y

# --- Idle task stack ---------------------------------------------------------
# Default 1536 bytes leaves only ~976 bytes free in AP mode before any client
# connects. Xtensa uses the interrupted task's stack for interrupt handlers,
# so when WiFi fires a level-1 interrupt on Core 1 while IDLE1 is in
# waiti 0, the interrupt chain overflows the idle task stack and corrupts the
# adjacent IPC task memory — producing the InstrFetchProhibited / PC=0 panic.
# 4096 bytes gives ~3.5 KB of interrupt headroom on both idle tasks.
CONFIG_FREERTOS_IDLE_TASK_STACKSIZE=4096

# --- C++ ---------------------------------------------------------------------
# We use C++17 features (std::unique_ptr, structured bindings, etc.).
CONFIG_COMPILER_CXX_EXCEPTIONS=n
CONFIG_COMPILER_CXX_RTTI=n

# Compile debug-level logging in (runtime default stays INFO; the app
# raises the NTPC tag to DEBUG at boot when the portal log level says so).
CONFIG_LOG_MAXIMUM_LEVEL_DEBUG=y
```
